## firmware/esp32/main/Kconfig.projbuild
```kconfig
menu "Cuadro Sonoro"

config SONORO_FIREBASE_DATABASE_URL
    string "URL pública de Firebase RTDB"
    default ""
    help
        URL pública de la base RTDB usada para la lectura del diagnóstico.
        No es un secreto ni contiene credenciales de servicio.

config SONORO_FIREBASE_STORAGE_BUCKET
    string "Bucket público de Firebase Storage"
    default ""
    help
        Bucket que contiene las portadas publicadas. Solo se descargan objetos
        individuales bajo el ámbito SHA-256 del identificador de prueba.

config SONORO_FRAME_TOKEN
    string "Identificador de cuadro para la prueba"
    default "charlie"
    help
        Identificador de prueba, no es una credencial.

endmenu
```

## firmware/esp32/sdkconfig.defaults
```kconfig
CONFIG_IDF_TARGET="esp32s3"
CONFIG_ESPTOOLPY_FLASHMODE_QIO=y
CONFIG_ESPTOOLPY_FLASHSIZE_16MB=y
CONFIG_ESP_DEFAULT_CPU_FREQ_MHZ_240=y
CONFIG_SPIRAM=y
CONFIG_SPIRAM_MODE_OCT=y
CONFIG_SPIRAM_SPEED_80M=y
CONFIG_SPIRAM_FETCH_INSTRUCTIONS=y
CONFIG_SPIRAM_RODATA=y
CONFIG_LV_OS_FREERTOS=y
CONFIG_LV_DEF_REFR_PERIOD=15
CONFIG_LV_USE_CLIB_MALLOC=y
CONFIG_LV_USE_CLIB_STRING=y
CONFIG_LV_USE_CLIB_SPRINTF=y
CONFIG_MBEDTLS_CERTIFICATE_BUNDLE=y
CONFIG_MBEDTLS_CERTIFICATE_BUNDLE_DEFAULT_FULL=y
CONFIG_LV_FONT_MONTSERRAT_16=y
CONFIG_LV_FONT_MONTSERRAT_20=y
CONFIG_LV_TXT_BREAK_CHARS=" ,.;:-_"
CONFIG_ESP_CONSOLE_USB_CDC=y
CONFIG_PARTITION_TABLE_CUSTOM=y
CONFIG_PARTITION_TABLE_CUSTOM_FILENAME="partitions.csv"
CONFIG_PARTITION_TABLE_OFFSET=0x8000
CONFIG_SPIRAM_USE_MALLOC=y
CONFIG_COMPILER_CXX_EXCEPTIONS=y
CONFIG_BSP_LCD_RGB_BUFFER_NUMS=2
CONFIG_BSP_DISPLAY_LVGL_AVOID_TEAR=y
CONFIG_BSP_DISPLAY_LVGL_DIRECT_MODE=y
```
